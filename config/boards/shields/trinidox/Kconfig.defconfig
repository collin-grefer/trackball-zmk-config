## config/boards/shields/trinidox/Kconfig.defconfig
```kconfig
if SHIELD_TRINIDOX_LEFT

    config ZMK_KEYBOARD_NAME
        default "Trinidox (Left)"

endif

if SHIELD_TRINIDOX_RIGHT

    config ZMK_KEYBOARD_NAME
        default "Trinidox (Right)"

    config ZMK_SPLIT_BLE_ROLE_CENTRAL
        default y

endif

if SHIELD_TRINIDOX_LEFT || SHIELD_TRINIDOX_RIGHT

    config ZMK_SPLIT
        default y

endif
```

## config/west.yml
```yaml
manifest:
  remotes:
    - name: zmk
      url-base: https://github.com/collin-grefer
  projects:
    - name: zmk
      remote: zmk
      revision: alpotato-pmw3360
      import: app/west.yml
  self:
    path: config
```
